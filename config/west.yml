## config/west.yml
```yaml
manifest:
  version: 0.13

  remotes:
    - name: zmkfirmware
      url-base: https://github.com/zmkfirmware
    - name: cormoran
      url-base: https://github.com/cormoran

  projects:
    # ZMK 本体：本家 main（最も安定）
    - name: zmk
      remote: zmkfirmware
      revision: main
      import: app/west.yml

    # PMW3610 ドライバ（cormoran 版）
    - name: zmk-pmw3610-driver
      remote: cormoran
      revision: main

    # DYA Studio モジュール（すべて cormoran）
    - name: zmk-module-ble-management
      remote: cormoran
      revision: main

    - name: zmk-module-battery-history
      remote: cormoran
      revision: main

    - name: zmk-module-settings-rpc
      remote: cormoran
      revision: main

    - name: zmk-module-runtime-input-processor
      remote: cormoran
      revision: main

  self:
    path: config
```
